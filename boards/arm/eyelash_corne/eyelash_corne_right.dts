/*
*
* Copyright (c) 2024 The ZMK Contributors
* SPDX-License-Identifier: MIT
*
*/

#include "eyelash_corne.dtsi"

&corne_transform {
    col-offset = <7>;
};

&sofle_transform {
    col-offset = <7>;
};
